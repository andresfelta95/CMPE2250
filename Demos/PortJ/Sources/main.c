/////////////////////////////////////////////////////////////////////////////
// HC12 Program:  YourProg - MiniExplanation
// Processor:     MC9S12XDP512
// Bus Speed:     20 MHz (Requires Active PLL)
// Author:        Andres Tangarife
// Details:       Program to test PortJ interrupt
// Date:          9/19/2022
// Revision History :
//  9/19/2022 - Initial Revision

/////////////////////////////////////////////////////////////////////////////
#include <hidef.h>      /* common defines and macros */
#include "derivative.h" /* derivative-specific definitions */
#include "LEDSW.h"
#include "lcd.h"
#include "ECT.h"
#include "Clock.h"
#include "SevSeg.h"

// other system includes or your includes go here
// #include "pll.h"
//#include "stdlib.h"
//#include "stdio.h"

/////////////////////////////////////////////////////////////////////////////
// Local Prototypes
/////////////////////////////////////////////////////////////////////////////

/////////////////////////////////////////////////////////////////////////////
// Global Variables
/////////////////////////////////////////////////////////////////////////////

/////////////////////////////////////////////////////////////////////////////
// Constants
/////////////////////////////////////////////////////////////////////////////

/////////////////////////////////////////////////////////////////////////////
// Main Entry
/////////////////////////////////////////////////////////////////////////////
void main(void)
{
  int iFreeCount = 0;
  // main entry point
  _DISABLE_COP();
  EnableInterrupts;

  /////////////////////////////////////////////////////////////////////////////
  // one-time initializations
  /////////////////////////////////////////////////////////////////////////////
  SwLED_Init();
  SevSeg_Init();
  // Set up PortJ for interrupts
  PTJ &= 0b11111100;  // clear ports 0 and 1
  DDRJ &= 0b11111100; // set ports 0 and 1 as inputs
  PPSJ |= 0b00000011; // set ports 0 and 1 as pull-ups or rising edge
  PIEJ |= 0b00000011; // enable interrupts for ports 0 and 1
  /////////////////////////////////////////////////////////////////////////////
  // main program loop
  /////////////////////////////////////////////////////////////////////////////
  for (;;)
  {
    unsigned long counter;

    /////////////////////////////////////////////////////
    asm sei; // suspend interrupts (set I in CCR)

    // do big delay to give a chance to push both buttons
    for (counter = 0; counter < 500000; counter++)
      ;
    asm cli; // permit interrupts (clear I in CCR)
    /////////////////////////////////////////////////////
    // counter will show when blocking delay is over
    SevSeg_Bot4(iFreeCount++);
    // fixup freecount on wrap
    if (iFreeCount > 9999)
      iFreeCount = 0;
  }
}

/////////////////////////////////////////////////////////////////////////////
// Functions
/////////////////////////////////////////////////////////////////////////////

/////////////////////////////////////////////////////////////////////////////
// Interrupt Service Routines (ISR)
/////////////////////////////////////////////////////////////////////////////
interrupt VectorNumber_Vportj void IntJ(void)
{
  if (PIFJ_PIFJ0) // read of PIFJ (22.3.2.61)
  {
    // ack interrupt
    // PIFJ_PIFJ0 = 1; // can't do R/W clearing (preserves other bits, so clears other flags!)
    PIFJ = PIFJ_PIFJ0_MASK; // write only clear (just this ONE bit)

    // show something happened:
    LED_Tog(LED_RED);
  }

  if (PIFJ_PIFJ1)
  {
    // ack interrupt
    PIFJ = PIFJ_PIFJ1_MASK; // write only clear
    // show something happened:
    LED_Tog(LED_GREEN);
  }
}
